#define U_TAPPING_TERM 250

#define U_MT(MOD, TAP) &u_mt MOD TAP
#define U_LT(LAYER, TAP) &u_lt LAYER TAP

{
  behaviors {
    u_mt: u_mt {
      compatible = "zmk,behavior-tap-dance";
      #binding-cells = <0>;
      tapping_term_ms = <U_TAPPING_TERM>;
    };
    u_lt: u_lt {
      compatible = "zmk,behavior-tap-dance"
      #binding-cells = <0>;
      tapping_term_ms = <U_TAPPING_TERM>;
    };
  };
};
